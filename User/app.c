/**
  ******************************************************************************
  * @file    app.c
  * @author  MCU SD
  * @version V1.0.0
  * @date    26-Dec-2014
  * @brief   Main routine
  ******************************************************************************
  */ 

/* Includes ------------------------------------------------------------------*/ 
#include "usbd_cdc_core.h"
#include "usbd_cdc_vcp.h"
#include "usbd_user.h"
#include "led.h"
#include "delay.h"
#include "stdio.h"
#include "temp.h"
#include "lcd.h"


u8 word2[] = 
{
0x02,0x12,0x12,0x12,0x3F,0x3F,0x22,0x32,0x7F,0x7F,0x7F,0x32,0x3B,0x1B,0x0A,0x00,
0x30,0x30,0x23,0x23,0xFE,0xFE,0x42,0x46,0xC6,0xFC,0xFC,0x7E,0xF6,0xEE,0x8E,0x00,
	
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0x00,0xFF,0xFF,0xFE,0xF6,0xF4,0xFE,0xFE,0xFE,0xF4,0xF4,0xFC,0xFE,0x0E,0x0E,0x04,
};


unsigned char DotTbl16[] =        // 数据表
{ 


0x01,0x41,0x41,0x41,0x7F,0x41,0x41,0x41,0x41,0x41,0x7F,0x41,0x41,0x41,0x01,0x00,0x00,0x01,0x02,0x0C,0xF0,0x00,0x00,0x00,0x00,0x00,0xFF,0x00,0x00,0x00,0x00,0x00,/*"开",0*/
0x00,0x1F,0x80,0x60,0x00,0x00,0x40,0x40,0x40,0x40,0x40,0x40,0x40,0x7F,0x00,0x00,0x00,0xFF,0x00,0x00,0x00,0x00,0x00,0x00,0x00,0x00,0x00,0x02,0x01,0xFE,0x00,0x00,/*"门",1*/
0x00,0x00,0x00,0x00,0x00,0x00,0x00,0x00,0x00,0x00,0x00,0x00,0x00,0x00,0x00,0x00,0x00,0x00,0x1A,0x1C,0x00,0x00,0x00,0x00,0x00,0x00,0x00,0x00,0x00,0x00,0x00,0x00,/*"，",2*/
0x02,0x22,0x24,0x25,0x29,0x31,0x21,0xFF,0x21,0x31,0x29,0x25,0x24,0x22,0x02,0x00,0x02,0x02,0x02,0xFA,0x52,0x52,0x52,0x52,0x52,0x52,0x52,0xFA,0x02,0x02,0x02,0x00,/*"查",3*/
0x00,0x04,0x04,0x04,0x05,0x06,0x00,0xFF,0x06,0x01,0x02,0x04,0x18,0x00,0x00,0x00,0x04,0x08,0x10,0x60,0x80,0x02,0x01,0xFE,0x00,0x80,0x40,0x20,0x10,0x08,0x08,0x00,/*"水",4*/
0x00,0x20,0x24,0x24,0x24,0x24,0x24,0xFF,0x24,0x24,0x24,0x24,0x24,0x20,0x00,0x00,0x84,0x84,0x88,0x90,0xBF,0xC1,0x82,0xC4,0xA0,0x90,0x88,0x94,0xA4,0x82,0x82,0x00,/*"表",5*/

};

unsigned char saohui[] =
{

0x00,0x00,0x1F,0x92,0x52,0x32,0x12,0x1F,0x12,0x32,0x52,0x92,0x1F,0x00,0x00,0x00,0x08,0x08,0xC8,0x48,0x48,0x48,0x48,0xFF,0x48,0x48,0x48,0x48,0xC8,0x08,0x08,0x00,/*"单",0*/
0x00,0x00,0x00,0x7F,0x04,0x04,0x04,0x04,0x04,0xFC,0x04,0x04,0x04,0x04,0x00,0x00,0x00,0x01,0x06,0xF8,0x40,0x40,0x40,0x40,0x40,0x40,0x7F,0x00,0x00,0x00,0x00,0x00,/*"片",1*/
0x08,0x08,0x0B,0xFF,0x09,0x08,0x00,0x7F,0x40,0x40,0x40,0x7F,0x00,0x00,0x00,0x00,0x20,0xC0,0x00,0xFF,0x00,0xC1,0x06,0xF8,0x00,0x00,0x00,0xFC,0x02,0x02,0x1E,0x00,/*"机",2*/
0x00,0x00,0x47,0x41,0x41,0x41,0x41,0x41,0x41,0x41,0x41,0x7F,0x00,0x00,0x00,0x00,0x00,0x00,0xFC,0x02,0x02,0x02,0x02,0x02,0x02,0x02,0x02,0x02,0x02,0x1E,0x00,0x00,/*"已",3*/
0x0F,0x00,0xFF,0x04,0x08,0x00,0x11,0x11,0xF2,0x1A,0x24,0x2A,0x21,0x27,0x00,0x00,0x01,0x0E,0xF0,0x08,0x04,0x41,0x42,0x4C,0x70,0x40,0x40,0x7C,0x42,0x42,0x4E,0x00,/*"烧",4*/
0x7F,0x49,0x89,0x01,0x49,0x49,0x7F,0x00,0x05,0x79,0x41,0x41,0x79,0x05,0x04,0x00,0x22,0x23,0x22,0x3E,0x24,0x24,0x24,0x01,0x01,0xC2,0x34,0x08,0x34,0xC2,0x01,0x00,/*"毁",5*/

};


extern void usbSend(char *str);
extern void sendText(char *str);
extern char isVCPReady(void);


extern int keyScan(void);
extern void keyInit(void);
 

/* Private variables ---------------------------------------------------------*/
USB_DEVICE_HANDLE  USB_Device_dev;

/* Private functions ---------------------------------------------------------*/
void show(unsigned char* arr, int num){
	int i;
	LCD_Clear();
	LCD_set_XY(0,0);

	for(i=0;i<num;i++){
		LCD_show_hanzi(2,16*i,arr+32*i);
	}
}

void showString(char* str){
	LCD_Clear();
	LCD_set_XY(0,0);
	LCD_show_string(str);
}

void showTemp(){
 		short temp=DS18B20_Get_Temp();
		char buf[16];
		if(temp<0){
			temp=-temp;	
			sprintf(buf,"-%d.%dC",temp/10,temp%10);
		}else{
			sprintf(buf,"%d.%dC",temp/10,temp%10);
		}
		showString(buf);
}

void displayTemp(){
 		short temp=DS18B20_Get_Temp();
		if(temp<0){
			temp=-temp;
			printf("-%d.%dC\r\n",temp/10,temp%10);
			if(isVCPReady()){
				char buf[16];
				sprintf(buf,"-%d.%dC\r\n",temp/10,temp%10);
				usbSend(buf);
			}
		}else{
			printf("%d.%dC\r\n",temp/10,temp%10);
			if(isVCPReady()){
				char buf[16];
				sprintf(buf,"%d.%dC\r\n",temp/10,temp%10);
				usbSend(buf);
			}
		}
}

void beep(){ //压电PA8
    GPIO_InitPara GPIO_InitStructure;
	int i;
	
	GPIO_InitStructure.GPIO_Pin = GPIO_PIN_8;
    GPIO_InitStructure.GPIO_Speed = GPIO_SPEED_50MHZ;
    GPIO_InitStructure.GPIO_Mode = GPIO_MODE_OUT_PP;
     
    RCC_APB2PeriphClock_Enable(RCC_APB2PERIPH_GPIOA, ENABLE);
    GPIO_Init(GPIOA, &GPIO_InitStructure);
	
	for(i=0; i<1000; i++){
		GPIO_SetBits(GPIOA,GPIO_PIN_8);
		delay_ms(1);
		GPIO_ResetBits(GPIOA,GPIO_PIN_8);
		delay_ms(1);
	}
}

/**
  * @brief  Main routine will construct a USB virtual ComPort device
  * @param  None
  * @retval None
  */
int main(void)
{	
	delay_init(72);
	if(0){
	    /* Hardware platform initialization */
	    USB_HWP_Init();
	
	    /* Configure usb clock */
	    USB_HWP_ClockConfig();
	
	    /* Configure USB interrupt */
	    USB_HWP_USBINTConfig();
	
	    /* USB device configuration */
	    USBD_Init(&USB_Device_dev,
	              &USER_desc,
	              &USBD_CDC_cb,
	              &USER_cb);
	
	    /* Connect the USB device */
	    USBD_Connect(&USB_Device_dev);
	}
	if(1){
		USART_InitPara USART_InitStructure;

        /* Usart1 default configuration */
        USART_InitStructure.USART_BRR = 115200;
        USART_InitStructure.USART_WL = USART_WL_8B;
        USART_InitStructure.USART_STBits = USART_STBITS_1;
        USART_InitStructure.USART_Parity = USART_PARITY_RESET;
        USART_InitStructure.USART_HardwareFlowControl = USART_HARDWAREFLOWCONTROL_NONE;
        USART_InitStructure.USART_RxorTx = USART_RXORTX_RX | USART_RXORTX_TX;

        /* Configure and enable the usart1 */
        GD_EVAL_COMInit(COM1, &USART_InitStructure);
	}
LCD_Init();
while(1);
	if(1){
		uint8_t i=0;
		signed char key,lastKey;
		char buf[16];
	
		keyInit();
		LCD_Init();
		ledInit();
		
		ledBlueOn();
		

		
		for(i=250; i>0; i--){
			sprintf(buf,"Start... %d", i++);
			showString(buf);
			//delay_ms(10);
		}
		while(key = DS18B20_Init()) {//初始化DS18B20,兼检测18B20
			sprintf(buf,"DS18B20 Failed! %d", i++);
			showString(buf);
			delay_ms(1000);
			if(i > 10) break;
		}
	    if(!key){
			showString("DS18B20 Ready!");
		}
			
		while(1){
			key = keyScan();
			if(key == 10){
				gpioOut(GPIOA, RCC_APB2PERIPH_GPIOA, GPIO_PIN_2, 1);
			}
			if(key != -1 && key != lastKey) {
				lastKey = key;
			
				LCD_Clear();
				LCD_set_XY(0,0);
				
				sprintf(buf,"keycode:%d",key);
				LCD_show_string(buf);

				switch(key){
				case 10: //电源
					
					break;
				case 5: //	清除
					show(DotTbl16,6);
					gpioOut(GPIOA, RCC_APB2PERIPH_GPIOA, GPIO_PIN_2, 0);
					break;
				case 1://	确认
					show(saohui,6);
					beep();
					break;
				case 0: //	蓝牙键
					showTemp();
					break;
				case 14://	取消				
					break;
				case 3://	0				
					ledRedOn();
					break;
				case 9://	1				
					ledRedOff();
					break;
				case 4://	2				
					ledInit();
					ledBlueOn();
					break;
				case 6://	3
					ledInit();				
					ledBlueOff();
					break;
				case 8://	4				
					ledYellowOn();
					break;
				case 13://	5				
					ledYellowOff();
					break;
				case 12://	6	
					ledLcdOn();			
					break;
				case 2://	7
					ledLcdOff();				
					break;
				case 7://	8	
					test18B20(1);
					break;
				case 15://	9	
					test18B20(0);			
					break;
				}
			}
		}
	}
}


/************************ (C) COPYRIGHT 2014 GIGADEVICE *****END OF FILE****/
